//------------------------------------------------------------------------------------------------------------------------------
//  Copyright (C) 2021, WESS-Global Inc., All Rights Reserved.
//
//  The information contained herein is confidential property of WESS-Global Inc. The use, copying, transfer or disclosure of
//  such information is prohibited except by express written agreement with WESS-Global Co.,LTD
//
//  $ Date: 2020-07-13 12:00:00 +0900 $
//------------------------------------------------------------------------------------------------------------------------------


//------------------------------------------------------------------------------------------------------------------------------
//  Includes
//------------------------------------------------------------------------------------------------------------------------------
// self
#include "screen_main.h"
// bsp
#include "lcd_main.h"
#include "lcd_data.h"
#include "btn_main.h"
// app
#include "data_main.h"
// disp
#include "disp_main.h"


//------------------------------------------------------------------------------------------------------------------------------
//  Global variables
//------------------------------------------------------------------------------------------------------------------------------


//------------------------------------------------------------------------------------------------------------------------------
//  Local variables
//------------------------------------------------------------------------------------------------------------------------------


//------------------------------------------------------------------------------------------------------------------------------
//  Local Funtions
//------------------------------------------------------------------------------------------------------------------------------
U08 lScr_idx;


//------------------------------------------------------------------------------------------------------------------------------
//  Global APIs - Access Local Variables
//------------------------------------------------------------------------------------------------------------------------------
// Get
U08 SCRN_GetScrnIdx(void)		{	return lScr_idx;		}
// Set


//------------------------------------------------------------------------------------------------------------------------------
//  Global APIs - Operation
//------------------------------------------------------------------------------------------------------------------------------
void SCRN_InitVari(void)
{
	lScr_idx = SCR_I00_IDLE + 1;

	ScTRD_InitVai();
}

void SCRN_ProcKey(U08 key)
{
	switch(key)
	{
		case BTN_IDX_RIGHT:
			if(++lScr_idx >= SCR_IDX_MAX)
				lScr_idx = SCR_I00_IDLE + 1;
			break;

		case BTN_IDX_LEFT:
			if(lScr_idx == SCR_I00_IDLE + 1)		lScr_idx = SCR_IDX_MAX - 1;
			else									lScr_idx--;
			break;
	}
}

void SCRN_ProcDisp(void)
{
	if(gTd_f_en)
	{
		LDT_UpdBuff(LCD_Y_START, LCD_Y_END);
		return;
	}

	LDT_ClrBuff(LCD_X_START, LCD_Y_START, LCD_X_END, LCD_Y_END);

	switch(lScr_idx)
	{
		case SCR_I01_FRONT:			DpFRT_ProcMain();				break;
		case SCR_I02_GRP_LIVE:
		case SCR_I03_GRP_AVRG:		DpGRP_ProcMain(lScr_idx);		break;
		case SCR_I04_INFO:			DpINF_ProcMain();				break;
		default:					return;
	}

	LDT_UpdBuff(LCD_Y_START, LCD_Y_END);
}


//------------------------------------------------------------------------------------------------------------------------------
//  EOF
//------------------------------------------------------------------------------------------------------------------------------

